## conf/distro/mono-sdk.conf
```bitbake
DISTRO = "mono-sdk"
DISTRO_NAME = "Mono Gateway SDK Linux Distribution"
DISTRO_VERSION = "1.0"
MAINTAINER = "Tomaz Zaman <tomaz@mono.si>"

# Use systemd as init manager
INIT_MANAGER = "systemd"
DISTRO_FEATURES:append = " systemd"
VIRTUAL-RUNTIME_init_manager = "systemd"
VIRTUAL-RUNTIME_initscripts = "systemd-compat-units"

# Minimal distro features - no wireless, audio, graphics, or extended permissions
DISTRO_FEATURES = "ext2 ipv4 ipv6 largefile systemd usbgadget usbhost"
DISTRO_FEATURES:append = " vpp pam virtualization polkit security"

# Package management
PACKAGE_CLASSES = "package_rpm"

# Security flags
SECURITY_CFLAGS = "-fstack-protector-strong -Wformat -Wformat-security -Werror=format-security"
SECURITY_NO_PIE_CFLAGS = "-fstack-protector-strong -Wformat -Wformat-security -Werror=format-security"

# Default timezone
DEFAULT_TIMEZONE = "UTC"

# Preferred providers
PREFERRED_PROVIDER_virtual/kernel = "linux-qoriq"

# Quality assurance checks
ERROR_QA:append = " textrel host-user-contaminated"
WARN_QA:append = " buildpaths ldflags"
```

## meta-mono-bsp/conf/layer.conf
```bitbake
BBPATH .= ":${LAYERDIR}"

BBFILES += "${LAYERDIR}/recipes-*/*/*.bb \
            ${LAYERDIR}/recipes-*/*/*.bbappend"

BBFILE_COLLECTIONS += "meta-mono-bsp"
BBFILE_PATTERN_meta-mono-bsp = "^${LAYERDIR}/"
BBFILE_PRIORITY_meta-mono-bsp = "10"

LAYERDEPENDS_meta-mono-bsp = "core"
LAYERSERIES_COMPAT_meta-mono-bsp = "walnascar"
```

## meta-mono-bsp/conf/machine/gateway-dk.conf
```bitbake
#@TYPE: Machine
#@NAME: Gateway Development Kit
#@DESCRIPTION: Machine configuration for Gateway Development Kit with LS1046A CPU
#@MAINTAINER: Tomaz Zaman <tomaz@mono.si>

MACHINEOVERRIDES =. "fsl-lsch2:qoriq-arm64:ls1046a:"

# CPU Architecture and tuning
require conf/machine/include/arm/armv8a/tune-cortexa72.inc

# QorIQ-specific variables
MACHINE_SOCARCH = "cortexa72"
SOC_FAMILY = "qoriq:ls1046a"

# Basic info about the hardware
MACHINE_FEATURES = "usbhost pci rtc serial"

# Support both real hardware (ttyS0) and QEMU (ttyAMA0)
SERIAL_CONSOLES = "115200;ttyS0"
SERIAL_CONSOLES:qemuarm64 = "115200;ttyAMA0"

# Kernel configuration
PREFERRED_PROVIDER_virtual/kernel = "linux-mono"

KERNEL_IMAGETYPE = "Image.gz"
KERNEL_DEVICETREE = "freescale/mono-gateway-dk.dtb"
KERNEL_DEVICETREE += "freescale/mono-gateway-dk-sdk.dtb"
KERNEL_DEVICETREE += "freescale/mono-gateway-dk-usdpaa-xg-only.dtb"

# Force initramfs integration into the kernel
INITRAMFS_IMAGE = "recovery-image"
INITRAMFS_IMAGE_NAME = "recovery-image.rootfs"
INITRAMFS_IMAGE_BUNDLE = "1"
INITRAMFS_MAXSIZE = "8388608"

# Firmware locations
RCWQSPI ?= "NN_FFSSPSNP_1133_5A06/rcw_2100_qspiboot.bin"
RCWEMMC ?= "NN_FFSSPSNP_1133_5A06/rcw_2100_emmcboot.bin"
FMAN_UCODE ?= "fsl_fman_ucode_ls1046_r1.0_108_4_9.bin"
```

## meta-mono-sdk/conf/layer.conf
```bitbake
BBPATH .= ":${LAYERDIR}"

BBFILES += "${LAYERDIR}/recipes-*/*/*.bb \
            ${LAYERDIR}/recipes-*/*/*.bbappend"

BBFILE_COLLECTIONS += "meta-mono-sdk"
BBFILE_PATTERN_meta-mono-sdk = "^${LAYERDIR}/"
BBFILE_PRIORITY_meta-mono-sdk = "11"

LAYERDEPENDS_meta-mono-sdk = "meta-mono-bsp"
LAYERSERIES_COMPAT_meta-mono-sdk = "walnascar"
```
